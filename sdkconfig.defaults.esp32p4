## sdkconfig.defaults.esp32p4
```kconfig
CONFIG_CAMERA_OV2640=y
CONFIG_CAMERA_OV2640_AUTO_DETECT_DVP_INTERFACE_SENSOR=y
CONFIG_CAMERA_OV2640_DVP_JPEG_320X240_50FPS=y
CONFIG_CAMERA_OV2640_DVP_DEFAULT_FMT_JPEG_320X240_50FPS=y
# CONFIG_CAMERA_OV2640_DVP_YUV422_640X480_6FPS is not set

CONFIG_EXAMPLE_ENABLE_DVP_CAM_SENSOR=y
CONFIG_EXAMPLE_ENABLE_MIPI_CSI_CAM_SENSOR=n
CONFIG_ESP_VIDEO_ENABLE_MIPI_CSI_VIDEO_DEVICE=n
CONFIG_EXAMPLE_SELECT_CUSTOMIZED_DEV_BOARD=y
CONFIG_EXAMPLE_SCCB_I2C_INIT_BY_APP=y
CONFIG_EXAMPLE_SCCB_I2C_PORT_INIT_BY_APP=0
CONFIG_EXAMPLE_SCCB_I2C_SCL_PIN_INIT_BY_APP=32
CONFIG_EXAMPLE_SCCB_I2C_SDA_PIN_INIT_BY_APP=33

CONFIG_EXAMPLE_DVP_SCCB_I2C_FREQ=100000
CONFIG_EXAMPLE_DVP_XCLK_FREQ=20000000
CONFIG_EXAMPLE_DVP_XCLK_PIN=-1
CONFIG_EXAMPLE_DVP_PCLK_PIN=28
CONFIG_EXAMPLE_DVP_VSYNC_PIN=29
CONFIG_EXAMPLE_DVP_DE_PIN=30
CONFIG_EXAMPLE_DVP_D0_PIN=18
CONFIG_EXAMPLE_DVP_D1_PIN=19
CONFIG_EXAMPLE_DVP_D2_PIN=20
CONFIG_EXAMPLE_DVP_D3_PIN=21
CONFIG_EXAMPLE_DVP_D4_PIN=22
CONFIG_EXAMPLE_DVP_D5_PIN=23
CONFIG_EXAMPLE_DVP_D6_PIN=26
CONFIG_EXAMPLE_DVP_D7_PIN=27
CONFIG_EXAMPLE_DVP_CAM_SENSOR_RESET_PIN=16
CONFIG_EXAMPLE_DVP_CAM_SENSOR_PWDN_PIN=17
CONFIG_XCAM_RAW_JPEG_STREAM=y

CONFIG_IDF_EXPERIMENTAL_FEATURES=y

CONFIG_ESP32P4_SELECTS_REV_LESS_V3=y
CONFIG_ESP32P4_REV_MIN_100=y

CONFIG_ESPTOOLPY_FLASHSIZE_16MB=y
CONFIG_ESP_CONSOLE_UART_CUSTOM=y
CONFIG_ESP_CONSOLE_UART_NUM=0
CONFIG_ESP_CONSOLE_UART_BAUDRATE=921600

CONFIG_SPIRAM=y
CONFIG_SPIRAM_SPEED_200M=y
```
